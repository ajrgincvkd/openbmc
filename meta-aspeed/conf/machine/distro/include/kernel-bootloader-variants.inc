## meta-aspeed/conf/machine/distro/include/kernel-bootloader-variants.inc
```bitbake
# Bootloader version selection
# Options: "openbmc" (default OpenBMC customized version) or "upstream" (community version)
BOOTLOADER_VARIANT ?= "openbmc"

# Kernel version selection
# Options: "openbmc" (default OpenBMC customized version) or "upstream" (community version 6.1)
KERNEL_VARIANT ?= "openbmc"

# Set PREFERRED_VERSION based on selected variants
PREFERRED_VERSION_u-boot ?= "2016.07%"
PREFERRED_VERSION_linux ?= "6.18.16%"

# Override with upstream versions if selected
PREFERRED_VERSION_u-boot:pn-u-boot-upstream ?= "2024.01%"
PREFERRED_VERSION_linux:pn-linux-upstream ?= "6.1%"

# Configure preferred recipes based on variant selection
PREFERRED_PROVIDER_virtual/bootloader = "${@'u-boot-upstream' if d.getVar('BOOTLOADER_VARIANT') == 'upstream' else 'u-boot'}"
PREFERRED_PROVIDER_virtual/kernel = "${@'linux-upstream' if d.getVar('KERNEL_VARIANT') == 'upstream' else 'linux-aspeed'}"
```

## meta-aspeed/conf/machine/example-machine.conf
```bitbake
#@TYPE: Machine
# Example Aspeed machine configuration with kernel and bootloader variant support
#
# This file shows how to configure a specific Aspeed machine to use
# either OpenBMC customized or upstream versions of kernel and U-Boot.
#
# Copy and modify this file for your specific machine.

# ============================================================================
# BASIC MACHINE SETTINGS
# ============================================================================

# Uncomment and set the appropriate target CPU based on your Aspeed SoC
# DEFAULTTUNE = "arm926ejs"       # AST2400, AST2500
# DEFAULTTUNE = "cortex-a7"       # AST2600, AST2700

require conf/machine/include/aspeed.inc


# ============================================================================
# KERNEL CONFIGURATION
# ============================================================================

# Specify kernel variant: "openbmc" (default) or "upstream"
KERNEL_VARIANT = "openbmc"

# For upstream Linux 6.1, customize the defconfig as needed
# EXTRA_KERNEL_CONFIG = " \
#     CONFIG_IPMI_HANDLER=y \
#     CONFIG_I2C=y \
#     CONFIG_ASPEED_WATCHDOG=y \
# "


# ============================================================================
# BOOTLOADER (U-BOOT) CONFIGURATION
# ============================================================================

# Specify bootloader variant: "openbmc" (default) or "upstream"
BOOTLOADER_VARIANT = "openbmc"

# U-Boot machine configuration - set based on your Aspeed SoC
# Common options for upstream U-Boot 2024.01:
UBOOT_MACHINE:pn-u-boot-upstream = "ast2600_defconfig"
# UBOOT_MACHINE:pn-u-boot-upstream = "ast2500_defconfig"
# UBOOT_MACHINE:pn-u-boot-upstream = "ast2700_defconfig"

# U-Boot version for OpenBMC (if using BOOTLOADER_VARIANT = "openbmc")
PREFERRED_VERSION_u-boot ?= "2016.07%"
# or use 2019.04 if preferred
# PREFERRED_VERSION_u-boot ?= "2019.04%"


# ============================================================================
# IMAGE CONFIGURATION
# ============================================================================

IMAGE_INSTALL:append = " \
    kernel-image \
    u-boot-script \
    u-boot-fw-utils \
"


# ============================================================================
# FLASH STORAGE CONFIGURATION
# ============================================================================

# Set the flash partition size if not defaulted
FLASH_SIZE ?= "64M"


# ============================================================================
# FEATURES
# ============================================================================

MACHINE_FEATURES = " \
    kernel26 \
    usbhost \
    ext2 \
    vfat \
    serial \
"

DISTRO_FEATURES:append = " \
    ipv6 \
    systemd \
    pam \
"


# ============================================================================
# EXAMPLE CONFIGURATION VARIANTS
# ============================================================================
#
# Uncomment the variant section that matches your requirements:
#

# Variant 1: Use OpenBMC customized versions (DEFAULT - comment out others)
# This uses the proven, well-tested OpenBMC configurations
# 
# KERNEL_VARIANT = "openbmc"
# BOOTLOADER_VARIANT = "openbmc"
# PREFERRED_VERSION_u-boot = "2016.07%"


# Variant 2: Use all upstream versions
# This uses modern upstream Linux 6.1 and U-Boot 2024.01
#
# KERNEL_VARIANT = "upstream"
# BOOTLOADER_VARIANT = "upstream"
# UBOOT_MACHINE:pn-u-boot-upstream = "ast2600_defconfig"


# Variant 3: Upstream kernel with OpenBMC U-Boot
# Useful for testing newer kernel while keeping proven bootloader
#
# KERNEL_VARIANT = "upstream"
# BOOTLOADER_VARIANT = "openbmc"
# PREFERRED_VERSION_u-boot = "2016.07%"


# Variant 4: OpenBMC kernel with upstream U-Boot
# For testing new U-Boot with proven kernel
#
# KERNEL_VARIANT = "openbmc"
# BOOTLOADER_VARIANT = "upstream"
# UBOOT_MACHINE:pn-u-boot-upstream = "ast2600_defconfig"


# ============================================================================
# MULTICONFIG USAGE
# ============================================================================
#
# To build both versions simultaneously, add to local.conf:
#
# BBMULTICONFIG = "openbmc upstream"
#
# Then build with:
#
# BBMULTICONFIG="openbmc upstream" bitbake \
#   multiconfig:openbmc:core-image-minimal \
#   multiconfig:upstream:core-image-minimal
#
# Output will be in:
#   build/tmp-openbmc/deploy/images/
#   build/tmp-upstream/deploy/images/
```
